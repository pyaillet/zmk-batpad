## boards/shields/boardsource2x3/Kconfig.defconfig
```kconfig
# Copyright (c) 2020 The ZMK Contributors
# SPDX-License-Identifier: MIT

if SHIELD_BOARDSOURCE2x3

config ZMK_KEYBOARD_NAME
    default "Boardsource 2x3"

endif
```

## boards/shields/boardsource2x3/Kconfig.shield
```kconfig
# Copyright (c) 2020 The ZMK Contributors
# SPDX-License-Identifier: MIT

config SHIELD_BOARDSOURCE2x3
    def_bool $(shields_list_contains,boardsource2x3)
```
